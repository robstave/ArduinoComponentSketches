/**
   ACS-85-0110
   ATTiny85  High Hat Sample player

   External pin 1       = Reset (not used)
   External pin 2 (PB3) = input 0  Sample Select
   External pin 3 (PB4) = input 1  not used
   External pin 4       = GND
   External pin 5 (PB0) = playing
   External pin 6 (PB1) = PWM
   External pin 7 (PB2) = Trigger
   External pin 8       = Vcc
   V 1.0  -  First Version

   This is mostly Jan Ostmans Sample code dsp-Host Drum8.
   In this case, all the samples are pretty
   short.

   It is set up for 8 samples, but does not use up all the slots.

   Sample select also tunes the sample.  There is no CV for that.
   ...but you could do that if you want.  Where the sample is selected
   is where things get different with this take on the code.

   Rob Stave (Rob the fiddler) 2023 GNU and Jan Ostman 2016 GNU
*/

//  ATTiny overview
//                           +-\/-+
//                    Reset 1|    |8  VCC
//(pin3) sample sel A3  PB3 2|    |7  PB2 (pin2) Trigger
//      (pin4) none A2  PB4 3|    |6  PB1 (pin1) PWM
//                      GND 4|    |5  PB0 (pin0) playing

//

// Copyright 2016 DSP Synthesizers Sweden.
//
// Author: Jan Ostman
//
// This program is free software: you can redistribute it and/or modify
// it under the terms of the GNU General Public License as published by
// the Free Software Foundation, either version 3 of the License, or
// (at your option) any later version.
// This program is distributed in the hope that it will be useful,
// but WITHOUT ANY WARRANTY; without even the implied warranty of
// MERCHANTABILITY or FITNESS FOR A PARTICULAR PURPOSE.  See the
// GNU General Public License for more details.

//  So, getting these samples are kinda a chore.
//  I got some samples from music radar.
//  I edited them to mono and clipped in Audacity.
//  Then I used https://www.online-convert.com/ to convert it to 8 bit 8k sampling rate.
//  Somehow, audacity does this, but It never worked for me. This site does it well.
//
//  Then I used this website to create the sample code.
//
//  https://synthworks.eu/attiny85-drum-creator/
// Attiny85 has only 8k to work with.  So I have only 5 samples

#include <avr/interrupt.h>
#include <avr/io.h>
#include <avr/pgmspace.h>

#ifndef cbi
#define cbi(sfr, bit) (_SFR_BYTE(sfr) &= ~_BV(bit))
#endif
#ifndef sbi
#define sbi(sfr, bit) (_SFR_BYTE(sfr) |= _BV(bit))
#endif

//--------- Ringbuf parameters ----------
uint8_t Ringbuffer[256];
uint8_t RingWrite = 0;
uint8_t RingRead = 0;
volatile uint8_t RingCount = 0;
//-----------------------------------------

const uint8_t drum1[] PROGMEM = {
    0x49, 0x4E, 0x46, 0x4F,
    0x49, 0x53, 0x46, 0x54, 0x0D, 0x00, 0x00, 0x00, 0x4C, 0x61, 0x76, 0x66, 0x36, 0x30, 0x2E, 0x35,
    0x2E, 0x31, 0x30, 0x30, 0x00, 0x00, 0x64, 0x61, 0x74, 0x61, 0xDC, 0x05, 0x00, 0x00, 0x80, 0x80,
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    0x81, 0x80, 0x80, 0x80, 0x81, 0x80, 0x80, 0x80, 0x80, 0x81};

const uint8_t drum2[] PROGMEM = {
    0x49, 0x4E, 0x46, 0x4F,
    0x49, 0x53, 0x46, 0x54, 0x0D, 0x00, 0x00, 0x00, 0x4C, 0x61, 0x76, 0x66, 0x36, 0x30, 0x2E, 0x35,
    0x2E, 0x31, 0x30, 0x30, 0x00, 0x00, 0x64, 0x61, 0x74, 0x61, 0x93, 0x04, 0x00, 0x00, 0x80, 0x80,
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    0x82, 0x80, 0x7D, 0x82, 0x7E, 0x80, 0x83, 0x7D, 0x83, 0x80, 0x7E, 0x83, 0x7D, 0x80, 0x81, 0x7E

};

const uint8_t drum3[] PROGMEM = {
    0x49, 0x4E, 0x46, 0x4F,
    0x49, 0x53, 0x46, 0x54, 0x0D, 0x00, 0x00, 0x00, 0x4C, 0x61, 0x76, 0x66, 0x36, 0x30, 0x2E, 0x35,
    0x2E, 0x31, 0x30, 0x30, 0x00, 0x00, 0x64, 0x61, 0x74, 0x61, 0x7E, 0x03, 0x00, 0x00, 0x80, 0x80,
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    0x85, 0x8A, 0x85, 0x84, 0x86, 0x7F, 0x82, 0x81, 0x89, 0x78, 0x88, 0x83};

const uint8_t drum4[] PROGMEM = {
    0x49, 0x4E, 0x46, 0x4F,
    0x49, 0x53, 0x46, 0x54, 0x0D, 0x00, 0x00, 0x00, 0x4C, 0x61, 0x76, 0x66, 0x36, 0x30, 0x2E, 0x35,
    0x2E, 0x31, 0x30, 0x30, 0x00, 0x00, 0x64, 0x61, 0x74, 0x61, 0x0D, 0x02, 0x00, 0x00, 0x8C, 0x6E,
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    0x7F, 0x80, 0x7F, 0x80, 0x7F

};

const uint8_t drum5[] PROGMEM = {
    0x49, 0x4E, 0x46, 0x4F,
    0x49, 0x53, 0x46, 0x54, 0x0D, 0x00, 0x00, 0x00, 0x4C, 0x61, 0x76, 0x66, 0x36, 0x30, 0x2E, 0x35,
    0x2E, 0x31, 0x30, 0x30, 0x00, 0x00, 0x64, 0x61, 0x74, 0x61, 0xC4, 0x02, 0x00, 0x00, 0x80, 0x80,
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    0x80, 0x81};

const uint8_t drum6[] PROGMEM = {};

const uint8_t drum7[] PROGMEM = {};

const uint8_t drum8[] PROGMEM = {

};

void setup()
{
  OSCCAL = 255;
  // Enable 64 MHz PLL and use as source for Timer1
  PLLCSR = 1 << PCKE | 1 << PLLE;

  // Set up Timer/Counter1 for PWM output
  TIMSK = 0;                                    // Timer interrupts OFF
  TCCR1 = 1 << PWM1A | 2 << COM1A0 | 1 << CS10; // PWM A, clear on match, 1:1 prescale
  // GTCCR = 1<<PWM1B | 2<<COM1B0;           // PWM B, clear on match
  OCR1A = 128; // OCR1B = 128;               // 50% duty at start

  pinMode(0, OUTPUT);
  pinMode(1, OUTPUT); // Enable PWM output pin
  // pinMode(2, INPUT_PULLUP);
  pinMode(2, INPUT); // rstave - change to pulldown

  // Set up Timer/Counter0 for 20kHz interrupt to output samples.

  TCCR0A = 3 << WGM00;             // Fast PWM
  TCCR0B = 1 << WGM02 | 2 << CS00; // 1/8 prescale
  TIMSK = 1 << OCIE0A;             // Enable compare match, disable overflow
  OCR0A = 49;                      // Divide by 400

  uint16_t dummy = analogRead(0);
}

void loop()
{
  uint16_t samplecnt1, samplecnt2, samplecnt3, samplecnt4, samplecnt5, samplecnt6, samplecnt7, samplecnt8;
  samplecnt1 = samplecnt2 = samplecnt3 = samplecnt4 = samplecnt5 = samplecnt6 = samplecnt7 = samplecnt8 = 0;

  uint16_t samplepnt1, samplepnt2, samplepnt3, samplepnt4, samplepnt5, samplepnt6, samplepnt7, samplepnt8;
  uint8_t dread2 = 0;
  uint8_t odread2 = 0;
  uint16_t valRead = 44;
  uint8_t Seldrum = 0;
  uint8_t MUX = 2;

  sbi(ADCSRA, ADSC); // start next conversation
  while (1)
  {
    if (RingCount < 32)
    { // if space in ringbuffer
      int16_t total = 0;
      if (samplecnt1)
      {
        total += (pgm_read_byte_near(drum1 + samplepnt1++) - 128);
        samplecnt1--;
      }
      if (samplecnt2)
      {
        total += (pgm_read_byte_near(drum2 + samplepnt2++) - 128);
        samplecnt2--;
      }
      if (samplecnt3)
      {
        total += (pgm_read_byte_near(drum3 + samplepnt3++) - 128);
        samplecnt3--;
      }
      if (samplecnt4)
      {
        total += (pgm_read_byte_near(drum4 + samplepnt4++) - 128);
        samplecnt4--;
      }
      if (samplecnt5)
      {
        total += (pgm_read_byte_near(drum5 + samplepnt5++) - 128);
        samplecnt5--;
      }
      if (samplecnt6)
      {
        total += (pgm_read_byte_near(drum6 + samplepnt6++) - 128);
        samplecnt6--;
      }
      if (samplecnt7)
      {
        total += (pgm_read_byte_near(drum7 + samplepnt7++) - 128);
        samplecnt7--;
      }
      if (samplecnt8)
      {
        total += (pgm_read_byte_near(drum8 + samplepnt8++) - 128);
        samplecnt8--;
      }

      // total >>= 1;
      total += 128;
      if (total > 255)
        total = 255;
      cli();
      uint16_t playing = samplecnt1 + samplecnt2 + samplecnt3 + samplecnt4 + samplecnt5 + samplecnt6 + samplecnt7 + samplecnt8;
      digitalWrite(0, playing);

      Ringbuffer[RingWrite] = total;
      RingWrite++;
      RingCount++;
      sei();
      dread2 = digitalRead(2);
      if (dread2 != odread2)
      {
        odread2 = dread2;
        if (odread2)
        {

          // Valread is being used for two purposes here.
          // Both as an indicator of the sample selected and a slight tuning.
          //  We are aiming for a range from 0 to 1023.
          //  IF its say 450...then thats the 3rd statement.
          //  So we select drum 2 and 127 - (457 -400) = 80 which is added to 88 for the interupt freq

          if (valRead < 200)
          {
            OCR0A = 88 + ((127 - (valRead >> 3)));
            Seldrum = 0;
          }
          else if (valRead < 400)
          {
            OCR0A = 88 + ((127 - ((valRead - 200) >> 3)));
            Seldrum = 1;
          }
          else if (valRead < 600)
          {
            OCR0A = 88 + ((127 - ((valRead - 400) >> 3)));
            Seldrum = 2;
          }
          else if (valRead < 800)
          {
            OCR0A = 88 + ((127 - ((valRead - 600) >> 3)));
            Seldrum = 3;
          }
          else
          {
            OCR0A = 88 + ((127 - ((valRead - 800) >> 3)));
            Seldrum = 4;
          }

          if (Seldrum == 0)
          {
            samplepnt1 = 0;
            samplecnt1 = sizeof(drum1);
          }
          if (Seldrum == 1)
          {
            samplepnt2 = 0;
            samplecnt2 = sizeof(drum2);
          }
          if (Seldrum == 2)
          {
            samplepnt3 = 0;
            samplecnt3 = sizeof(drum3);
          }
          if (Seldrum == 3)
          {
            samplepnt4 = 0;
            samplecnt4 = sizeof(drum4);
          }
          if (Seldrum == 4)
          {
            samplepnt5 = 0;
            samplecnt5 = sizeof(drum5);
          }
          if (Seldrum == 5)
          {
            samplepnt6 = 0;
            samplecnt6 = sizeof(drum6);
          }
          if (Seldrum == 6)
          {
            samplepnt7 = 0;
            samplecnt7 = sizeof(drum7);
          }
          if (Seldrum == 7)
          {
            samplepnt8 = 0;
            samplecnt8 = sizeof(drum8);
          }
        }
      }

      if (!(ADCSRA & 64))
      {
        if (MUX == 2)
        {
          // not used but availible
        }
        if (MUX == 3)
        {
          // Seldrum = ((ADCL + (ADCH << 8)) >> 7);
          valRead = ((ADCL + (ADCH << 8)));
        }
        MUX++;
        if (MUX == 4)
          MUX = 2;
        ADMUX = MUX;       // Select MUX
        sbi(ADCSRA, ADSC); // start next conversation
      }
    }
  }
}

ISR(TIMER0_COMPA_vect)
{
  //-------------------  Ringbuffer handler -------------------------

  if (RingCount)
  {                                   // If entry in FIFO..
    OCR1A = Ringbuffer[(RingRead++)]; // Output 8-bit DAC
    RingCount--;
  }

  //-----------------------------------------------------------------
}
